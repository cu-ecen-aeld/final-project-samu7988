## base_external/package/aesd-char/Config.in
```kconfig
config BR2_PACKAGE_AESD_CHAR
	bool "aesd-char"
	help
	  Includes the aesd character device(circular buffer) package.
	  Used to understand buildroot external trees and package builds.
```
